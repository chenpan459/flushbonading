# SSE315 register map
Vendor: ARM Ltd.; Series: ARMv8.1-M Mainline; File version: 1.0
CPU: CM85 r0p0, little endian, MPU, FPU, 3 interrupt priority bits, 8 SAU regions
Registers are 32-bit, read-write, reset 0x0 unless marked. A register's access mark holds for its fields unless they carry their own. Offsets are from the block's base; [hi:lo] are bit positions; {n}, {i} and the like mark numbered series.

## LCM — Lifecycle Manager (Secure)
Base 0x500A0000
0x00 LCS_VALUE ro reset 0xEEEEA5A5 — LCS indication
0x04 KEY_ERR ro reset 0x3F — Zero count error status of the OTP keys
0x08 TP_MODE ro reset 0x2222AA55
0x0C FATAL_ERR — LCM Fatal Error FSM state enable
0x10 DM_RMA_LOCK — DM RMA OTP flag lock enable
0x14 SP_ENABLE — Secure provisioning enable
0x18 OTP_ADDR_WIDTH ro — Value of the OTP_ADDR_WIDTH configuration parameter that defines the integrated OTP address width.
0x1C OTP_SIZE_IN_BYTES ro — Value of the OTP_SIZE_IN_BYTES configuration parameter that defines the integrated OTP size in bytes
0x20 GPPC ro — General Purpose Persistent Configuration (GPPC) value
{0x100+4i} DCU_EN{i} (i=0..3) — Bits {32i+31}:{32i} of the 128-bit DCU enable register (DCU_EN)
{0x110+4i} DCU_LOCK{i} (i=0..3) — Bits {32i+31}:{32i} of the 128-bit DCU lock register (DCU_LOCK)
0x120 DCU_SP_DISABLE_MASK0 ro reset 0xFFFFFFFF — Bits 31:0 of the 128-bit DCU_SP_DISABLE_MASK_VAL parameter value
{0x120+4i} DCU_SP_DISABLE_MASK{i} ro reset 0xFFFFFFFF (i=1..3) — Bits {32i+31}:{32i} of the 128-bit DCU_SP_DISABLE_MASK_VAL parameter value.
{0x130+4i} DCU_DISABLE_MASK{i} ro reset 0xFFFFFFFF (i=0..3) — Bits {32i+31}:{32i} of the 128-bit PERMANENT_DISABLE_MASK parameter value, according to the current LCS.
0xFD0 Peripheral_ID_4 ro reset 0xF4
0xFE0 Peripheral_ID_0 ro reset 0xF5
0xFE4 Peripheral_ID_1 ro reset 0xB0
0xFE8 Peripheral_ID_2 ro reset 0xB
0xFEC Peripheral_ID_3 ro
0xFF0 Component_ID_0 ro reset 0xD
0xFF4 Component_ID_1 ro reset 0xF0
0xFF8 Component_ID_2 ro reset 0x5
0xFFC Component_ID_3 ro reset 0xB1

## SAM — Security Alarm Manager (Secure)
Base 0x58042000
0x00 SAMBC ro — SAM Build Configuration register.
0x04 SAMES0 ro — SAM Event Status register 0.
0x08 SAMES1 ro — SAM Event Status register 1.
0x0C SAMECL0 wo — SAM Event Clear register 0.
0x10 SAMECL1 wo — SAM Event Clear register 1.
0x14 SAMEM0 — SAMEM0RVAL SAM Export Mask 0.
0x18 SAMEM1 — SAMEM1RVAL SAM Export Mask 1.
0x1C SAMIM0 — SAMIM0RVAL SAM Input Mask 0 register.
0x20 SAMIM1 — SAMIM1RVAL SAM Input Mask 1 register.
{0x24+4i} SAMRRLS{i} (i=0..7) — SAMRRLS{i}RVAL SAM Response Routing Logic Setup register {i}.
{0x44+4i} SAMEC{i} (i=0..7) — SAMEC{i}RVAL SAM Event Counter register {i}.
0x64 SAMECTIV — SAMECTIVRVAL SAM Event Counters Timer Initial Value register.
0x68 SAMWDCIV — SAMWDCIVRVAL SAM Watchdog Counter Initial Value register.
0x6C SAMRL — SAM Registers Lock register.
0x70 SAMICV — SAM Integrity Check Value.
0x74 SAMCDRES — SAM Processor DCLS Reported Errors Status register.
{0x78+4i} SAMRRES{i} (i=0..2) — SAM Processor RAS Reported Errors Status {i} register.
{0x84+4i} VMPWCA{i} (i=0..3) — VM{i} Partial Write Captured Address.
{0x94+4i} VMSCEECA{i} (i=0..3) — VM{i} Single Corrected EEC Error Captured Address.
{0xA4+4i} VMDUEECA{i} (i=0..3) — VM{i} Double Uncorrected EEC Error Captured Address.
0xB4 TRAMSCEECA — TRAM Single Corrected ECC Error Captured Address
0xB8 TRAMDUEECA — TRAM Double Uncorrected ECC Error Captured Address
0xFD0 PIDR4 ro reset 0x4 — The Peripheral ID4 register returns byte[4] of the peripheral ID.
0xFE0 PIDR0 ro reset 0xF2 — The Peripheral ID0 register returns byte[0] of the peripheral ID.
0xFE4 PIDR1 ro reset 0xB0 — The Peripheral ID1 register returns byte[1] of the peripheral ID.
0xFE8 PIDR2 ro reset 0x1B — The Peripheral ID2 register returns byte[2] of the peripheral ID.
0xFEC PIDR3 ro — The Peripheral ID3 register returns byte[3] of the peripheral ID.
0xFF0 CIDR0 ro reset 0xD — The Component ID0 register returns byte[0] of the component ID.
0xFF4 CIDR1 ro reset 0xF0 — The Component ID1 register returns byte[1] of the component ID.
0xFF8 CIDR2 ro reset 0x5 — The Component ID2 register returns byte[2] of the component ID.
0xFFC CIDR3 ro reset 0xB1 — The Component ID3 register returns byte[3] of the component ID.

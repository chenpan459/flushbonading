# SSE320 register map
Vendor: ARM Ltd.; Series: ARMv8.1-M Mainline; File version: 1.0
ARM 32-bit v8.1-M Mainline based device
CPU: CM85 r0p0, little endian, MPU, FPU, 3 interrupt priority bits, 8 SAU regions
Registers are 32-bit, read-write, reset 0x0 unless marked. A register's access mark holds for its fields unless they carry their own. Offsets are from the block's base; lines under a group give offsets from that group; [hi:lo] are bit positions; {n}, {i} and the like mark numbered series; 'fields as' and 'values as' point back to an identical list; <NAME> marks a mode.

## Memory map
0x40080000 NSACRB size 0x1000 — Non-secure Access Configuration Register Block
0x40100000 GPIO0 size 0x3C — General-purpose I/O 0
0x40101000 GPIO1 size 0x3C — General-purpose I/O 1
0x40102000 GPIO2 size 0x3C — General-purpose I/O 2
0x40103000 GPIO3 size 0x3C — General-purpose I/O 3
0x40310000 HDLCD size 0x1000 — HDLCD (Non-Secure)
0x40400000 Ethernet size 0x100000
0x40500000 USB size 0x100000
0x48000000 TIMER0 size 0x1000
0x48001000 TIMER1 size 0x1000
0x48002000 TIMER2 size 0x1000
0x48003000 TIMER3 size 0x1000 — AON Timer 3
0x48020000 SYSINFO size 0x1000 — System Information
0x4802F000 SLOWCLK size 0x10 — SLOWCLK AON Timer
0x48040000 WATCHDOG size 0x1FD0 — Non-secure Watchdog Timer
0x48100000 I2C0 size 0xC — I2C Touch
0x48101000 SYSCOUNTER_READ size 0x1000 — System counter read
0x48102000 SSP0 size 0x90 — SPI 0 ADC
0x48103000 SSP1 size 0x90 — SPI 1 SHIELD0
0x48105000 I2C1 size 0xC — I2C SHIELD0
0x48106000 I2C2 size 0xC — I2C SHIELD1
0x48108000 I2C3 size 0xC — I2C EEPROM
0x48109000 I2C3 size 0xC — I2C Audio Conf
0x48200000 SCC size 0x1000 — Serial Communication Controller
0x48201000 AudioI2S size 0x1000
0x48202000 FPGAIO size 0x100 — FPGA System Control I/O
0x48203000 UART0 size 0x14
0x48204000 UART1 size 0x14
0x48205000 UART2 size 0x14
0x48206000 UART3 size 0x14
0x48207000 UART4 size 0x14
0x48208000 UART5 size 0x14
0x49204000 SSP2 size 0x90 — SPI 2 SHIELD1
0x50080000 SACRB size 0x1000 — Secure Access Configuration Register Block
0x50083000 ISRAM0MPC size 0x1000 — ISRAM 0 Memory Protection Controller
0x50084000 ISRAM1MPC size 0x1000 — ISRAM 1 Memory Protection Controller
0x5009E000 KMU size 0x1000 — Key Management Unit (Secure)
0x500A0000 LCM size 0x10000 — Lifecycle Manager (Secure)
0x50100000 GPIO0_Secure size 0x3C — General-purpose I/O 0 (Secure)
0x50101000 GPIO1_Secure size 0x3C — General-purpose I/O 1 (Secure)
0x50102000 GPIO2_Secure size 0x3C — General-purpose I/O 2 (Secure)
0x50103000 GPIO3_Secure size 0x3C — General-purpose I/O 3 (Secure)
0x50310000 HDLCD_Secure size 0x1000
0x58000000 TIMER0_Secure size 0x1000
0x58001000 TIMER1_Secure size 0x1000
0x58002000 TIMER2_Secure size 0x1000
0x58003000 TIMER3_Secure size 0x1000
0x58020000 SYSINFO_Secure size 0x1000 — System Information (Secure)
0x58021000 SYSCONTROL size 0x1000 — System Control
0x5802E000 SLOWCLKWATCHDOG size 0x10 — SLOWCLK Watchdog (Secure)
0x5802F000 SLOWCLK_Secure size 0x10 — SLOWCLK AON Timer (Secure)
0x58040000 WATCHDOG_Secure size 0x1FD0
0x58042000 SAM size 0x1000 — Security Alarm Manager (Secure)
0x58100000 SYSCOUNTER_CNTRL size 0x1000 — System counter control
0x58100000 I2C0_Secure size 0xC — I2C Touch (Secure)
0x58101000 SYSCOUNTER_READ_Secure size 0x1000 — System Counter Read (Secure)
0x58102000 SSP0_Secure size 0x90 — SPI 0 ADC (Secure)
0x58103000 SSP1_Secure size 0x90 — SPI 1 SHIELD0 (Secure)
0x58104000 SSP2_Secure size 0x90 — SPI 2 SHIELD1 (Secure)
0x58105000 I2C2 size 0xC — I2C SHIELD0 (Secure)
0x58106000 I2C3 size 0xC — I2C SHIELD1 (Secure)
0x58108000 I2C3 size 0xC — I2C EEPROM
0x58109000 I2C3 size 0xC — I2C Audio Conf
0x58200000 SCC_Secure size 0x1000 — Serial Communication Controller
0x58202000 FPGAIO_Secure size 0x100 — FPGA System Control I/O (Secure)
0x58203000 UART0_Secure size 0x14
0x58204000 UART1_Secure size 0x14
0x58205000 UART2_Secure size 0x14
0x58206000 UART3_Secure size 0x14
0x58207000 UART4_Secure size 0x14
0x58208000 UART5_Secure size 0x14
0xE000EDD0 SAU size 0x20 — Security Attribution Unit

## Interrupts
0 NONSEC_WATCHDOG_RST_REQ (WATCHDOG) — Non-Secure Watchdog reset Request
1 NONSEC_WATCHDOG_IRQ (WATCHDOG) — Non-Secure Watchdog Interrupt
2 S32K_TIMER (SLOWCLK)
3 TIMER0
4 TIMER1
5 DUALTIMER (TIMER2) — Timer 2
9 MPC (ISRAM0MPC) — MPC Combined
10 PPC (SACRB) — PPC Combined
11 MSC (SACRB) — MSC Combined
12 BRG (SACRB) — Bridge Buffer Error
14 MGMT_PPU (SYSCONTROL)
15 SYS_PPU (SYSCONTROL)
16 CPU0_PPU (SYSCONTROL)
20 KMU
26 PPU_DEBUG (SYSCONTROL)
27 TIMER3
30 SAM_CSFI (SAM) — Critical Severity Fault Interrupt
31 SAM_SFI (SAM) — Severity Fault Interrupt
32 System_Timestamp_Counter (SYSCOUNTER_CNTRL)
33 UART0_RX (UART0)
34 UART0_TX (UART0)
35 UART1_RX (UART1)
36 UART1_TX (UART1)
37 UART2_RX (UART2)
38 UART2_TX (UART2)
39 UART3_RX (UART3)
40 UART3_TX (UART3)
41 UART4_RX (UART4)
42 UART4_TX (UART4)
43 UART0_COMBINED (UART0) — UART 0 Combined interrupt
44 UART1_COMBINED (UART1) — UART 1 Combined interrupt
45 UART2_COMBINED (UART2) — UART 2 Combined interrupt
46 UART3_COMBINED (UART3) — UART 3 Combined interrupt
47 UART4_COMBINED (UART4) — UART 4 Combined interrupt
48 UART_OVERFLOW (UART5) — UART 0 to 5 combined overflow/overrun
49 Ethernet
50 AudioI2S
69 GPIO0_COMBINED (GPIO0)
70 GPIO1_COMBINED (GPIO1)
71 GPIO2_COMBINED (GPIO2)
72 GPIO3_COMBINED (GPIO3)
125 UART5_RX (UART5)
126 UART5_TX (UART5)
127 UART5_COMBINED (UART5) — UART 5 Combined interrupt
133 HDLCD

## Licence text in the file
ARM Limited (ARM) is supplying this software for use with Cortex-M processor based microcontroller, but can be equally used for other suitable processor architectures. This file can be freely distributed. Modifications to this file shall be clearly marked. . THIS SOFTWARE IS PROVIDED "AS IS". NO WARRANTIES, WHETHER EXPRESS, IMPLIED. OR STATUTORY, INCLUDING, BUT NOT LIMITED TO, IMPLIED WARRANTIES OF. MERCHANTABILITY AND FITNESS FOR A PARTICULAR PURPOSE APPLY TO THIS SOFTWARE. ARM SHALL NOT, IN ANY CIRCUMSTANCES, BE LIABLE FOR SPECIAL, INCIDENTAL, OR. CONSEQUENTIAL DAMAGES, FOR ANY REASON WHATSOEVER.

## Notices in the file
Copyright (C) 2012-2022 ARM Limited. All rights reserved.
Purpose: System Viewer Description (SVD) Example (Schema Version 1.1)
This is a description of a none-existent and incomplete device
for demonstration purposes only.
Redistribution and use in source and binary forms, with or without
modification, are permitted provided that the following conditions are met:
- Redistributions of source code must retain the above copyright
notice, this list of conditions and the following disclaimer.
- Redistributions in binary form must reproduce the above copyright
notice, this list of conditions and the following disclaimer in the
documentation and/or other materials provided with the distribution.
- Neither the name of ARM nor the names of its contributors may be used
to endorse or promote products derived from this software without
specific prior written permission.
THIS SOFTWARE IS PROVIDED BY THE COPYRIGHT HOLDERS AND CONTRIBUTORS "AS IS"
AND ANY EXPRESS OR IMPLIED WARRANTIES, INCLUDING, BUT NOT LIMITED TO, THE
ARE DISCLAIMED. IN NO EVENT SHALL COPYRIGHT HOLDERS AND CONTRIBUTORS BE
LIABLE FOR ANY DIRECT, INDIRECT, INCIDENTAL, SPECIAL, EXEMPLARY, OR
CONSEQUENTIAL DAMAGES (INCLUDING, BUT NOT LIMITED TO, PROCUREMENT OF
SUBSTITUTE GOODS OR SERVICES; LOSS OF USE, DATA, OR PROFITS; OR BUSINESS
INTERRUPTION) HOWEVER CAUSED AND ON ANY THEORY OF LIABILITY, WHETHER IN
CONTRACT, STRICT LIABILITY, OR TORT (INCLUDING NEGLIGENCE OR OTHERWISE)
ARISING IN ANY WAY OUT OF THE USE OF THIS SOFTWARE, EVEN IF ADVISED OF THE
POSSIBILITY OF SUCH DAMAGE.
